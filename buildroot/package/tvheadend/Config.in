## buildroot/package/tvheadend/Config.in
```kconfig
comment "tvheadend requires a toolchain with LARGEFILE and IPV6 support"
    depends on !(BR2_LARGEFILE && BR2_INET_IPV6)

config BR2_PACKAGE_TVHEADEND
 bool "tvheadend"
 depends on BR2_LARGEFILE && BR2_INET_IPV6
 select BR2_PACKAGE_OPENSSL
 select BR2_PACKAGE_LIBICONV
 help
   Tvheadend is a TV streaming server for Linux supporting DVB-S,
   DVB-S2, DVB-C, DVB-T, ATSC, and IPTV as input sources.
   
   https://tvheadend.org
   
   Note:
     - a default user has been created to log in the web configuration
       GUI: admin/admin; you can change it at your discretion at runtime.
     - if you want Avahi support, you'll need to enable:
           Avahi, D-Bus, libdaemon
```
